## ESP32/main/Kconfig.projbuild
```kconfig
menu "Example Configuration"

    config BROKER_URL
        string "Broker URL"
        default "mqtt://192.168.158.41"
        help
            URL of the broker to connect to

    config BROKER_URL_FROM_STDIN
        bool
        default y if BROKER_URL = "FROM_STDIN"

    config EXAMPLE_FORMAT_IF_MOUNT_FAILED
        bool "Format the card if mount failed"
        default n
        help
            If this config item is set, format_if_mount_failed will be set to true and the card will be formatted if
            the mount has failed.

    config EXAMPLE_FORMAT_SD_CARD
        bool "Format the card as a part of the example"
        default n
        help
            If this config item is set, the card will be formatted as a part of the example.

    config EXAMPLE_PIN_MOSI
        int "MOSI GPIO number"
        default 15 if IDF_TARGET_ESP32
        default 35 if IDF_TARGET_ESP32S2
        default 35 if IDF_TARGET_ESP32S3
        default 5  if IDF_TARGET_ESP32H2
        default 11 if IDF_TARGET_ESP32P4
        default 4  # C3 and others

    config EXAMPLE_PIN_MISO
        int "MISO GPIO number"
        default 2 if IDF_TARGET_ESP32
        default 37 if IDF_TARGET_ESP32S2
        default 37 if IDF_TARGET_ESP32S3
        default 0  if IDF_TARGET_ESP32H2
        default 13 if IDF_TARGET_ESP32P4
        default 6  # C3 and others

    config EXAMPLE_PIN_CLK
        int "CLK GPIO number"
        default 14 if IDF_TARGET_ESP32
        default 36 if IDF_TARGET_ESP32S2
        default 36 if IDF_TARGET_ESP32S3
        default 4  if IDF_TARGET_ESP32H2
        default 12 if IDF_TARGET_ESP32P4
        default 5  # C3 and others

    config EXAMPLE_PIN_CS
        int "CS GPIO number"
        default 13 if IDF_TARGET_ESP32
        default 34 if IDF_TARGET_ESP32S2
        default 34 if IDF_TARGET_ESP32S3
        default 10 if IDF_TARGET_ESP32P4
        default 1  # C3 and others

endmenu

menu "Application Configuration"

	choice POLARITY
		prompt "Communication Polarity"
		default PRIMARY
		help
			Select Communication Polarity.
		config PRIMARY
			bool "Primary"
			help
				As Echo Client.
		config SECONDARY
			bool "Secondary"
			help
				As Echo Server.
	endchoice

endmenu 

menu "nRF24L01 Configuration"

	config GPIO_RANGE_MAX
		int
		default 33 if IDF_TARGET_ESP32
		default 46 if IDF_TARGET_ESP32S2
		default 48 if IDF_TARGET_ESP32S3
		default 18 if IDF_TARGET_ESP32C2
		default 19 if IDF_TARGET_ESP32C3
		default 30 if IDF_TARGET_ESP32C6

	config RADIO_CHANNEL
		int "Channel number"
		range 0 127
		default 90
		help
			Channel number.

	config MISO_GPIO
		int "MISO GPIO number"
		range 0 GPIO_RANGE_MAX
		default 19 if IDF_TARGET_ESP32
		default 37 if IDF_TARGET_ESP32S2 || IDF_TARGET_ESP32S3
		default  4 # C3 and others
		help
			GPIO number (IOxx) to SPI MISO.
			Some GPIOs are used for other purposes (flash connections, etc.) and cannot be used to MISO.
			On the ESP32, GPIOs 35-39 are input-only so cannot be used as outputs.
			On the ESP32-S2, GPIO 46 is input-only so cannot be used as outputs.

	config SCLK_GPIO
		int "SCLK GPIO number"
		range 0 GPIO_RANGE_MAX
		default 18 if IDF_TARGET_ESP32
		default 36 if IDF_TARGET_ESP32S2 || IDF_TARGET_ESP32S3
		default  3 # C3 and others
		help
			GPIO number (IOxx) to SPI SCLK.
			Some GPIOs are used for other purposes (flash connections, etc.) and cannot be used to SCLK.
			On the ESP32, GPIOs 35-39 are input-only so cannot be used as outputs.
			On the ESP32-S2, GPIO 46 is input-only so cannot be used as outputs.

	config MOSI_GPIO
		int "MOSI GPIO number"
		range 0 GPIO_RANGE_MAX
		default 23 if IDF_TARGET_ESP32
		default 35 if IDF_TARGET_ESP32S2 || IDF_TARGET_ESP32S3
		default  2 # C3 and others
		help
			GPIO number (IOxx) to SPI MOSI.
			Some GPIOs are used for other purposes (flash connections, etc.) and cannot be used to MOSI.
			On the ESP32, GPIOs 35-39 are input-only so cannot be used as outputs.
			On the ESP32-S2, GPIO 46 is input-only so cannot be used as outputs.

	config CE_GPIO
		int "CE GPIO number"
		range 0 GPIO_RANGE_MAX
		default 16 if IDF_TARGET_ESP32
		default 34 if IDF_TARGET_ESP32S2 || IDF_TARGET_ESP32S3
		default  1 # C3 and others
		help
			GPIO number (IOxx) to CE.
			Some GPIOs are used for other purposes (flash connections, etc.) and cannot be used to CE.
			On the ESP32, GPIOs 35-39 are input-only so cannot be used as outputs.
			On the ESP32-S2, GPIO 46 is input-only so cannot be used as outputs.

	config CSN_GPIO
		int "CSN GPIO number"
		range 0 GPIO_RANGE_MAX
		default 17 if IDF_TARGET_ESP32
		default 33 if IDF_TARGET_ESP32S2 || IDF_TARGET_ESP32S3
		default  0 # C3 and others
		help
			GPIO number (IOxx) to CSN.
			Some GPIOs are used for other purposes (flash connections, etc.) and cannot be used to CSN.
			On the ESP32, GPIOs 35-39 are input-only so cannot be used as outputs.
			On the ESP32-S2, GPIO 46 is input-only so cannot be used as outputs.

	choice SPI_HOST
		prompt "SPI peripheral that controls this bus"
		default SPI2_HOST
		help
			Select SPI peripheral that controls this bus.
		config SPI2_HOST
			bool "SPI2_HOST"
			help
				Use SPI2_HOST. This is also called HSPI_HOST.
		config SPI3_HOST
			depends on IDF_TARGET_ESP32 || IDF_TARGET_ESP32S2 || IDF_TARGET_ESP32S3
			bool "SPI3_HOST"
			help
				USE SPI3_HOST. This is also called VSPI_HOST
	endchoice

	config ADVANCED
		bool "Enable Advanced Setting"
		default false
		help
			Enable Advanced Setting.

	choice RF_RATIO
		depends on ADVANCED
		prompt "RF Data Ratio"
		default RF_RATIO_2M
		help
			Select RF Data Ratio.
		config RF_RATIO_2M
			bool "2Mbps"
			help
				RF Data Ratio is 2Mbps.
		config RF_RATIO_1M
			bool "1Mbps"
			help
				RF Data Ratio is 1Mbps.
		config RF_RATIO_250K
			bool "250Kbps"
			help
				RF Data Ratio is 250Kbps.
	endchoice

	config RETRANSMIT_DELAY
		depends on ADVANCED
		int "Auto Retransmit Delay"
		range 0 15
		default 0
		help
			Set Auto Retransmit Delay.
			Delay = value * 250us.

endmenu 
```
